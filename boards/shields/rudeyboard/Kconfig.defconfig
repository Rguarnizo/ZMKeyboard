## boards/shields/rudeyboard/Kconfig.defconfig
```kconfig
if SHIELD_RUDEYBOARD

config ZMK_KEYBOARD_NAME
    default "Rudeyboard"

config I2C
    default y

endif
```

## boards/shields/rudeyboard/Kconfig.shield
```kconfig
# Copyright (c) 2020 Pete Johanson
# SPDX-License-Identifier: MIT

config SHIELD_RUDEYBOARD
    def_bool $(shields_list_contains,rudeyboard)

config I2C
    default y

config ZMK_KSCAN_MATRIX_POLLING
    default y

config GPIO_MCP230XX
    default y

endif
```
